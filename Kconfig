## Kconfig
```kconfig
# Kconfig for rts log

menu "rts log"

config RTS_LOG_ENABLE
    bool "Enable rts log"
    default y
    help
        Select this to enable the rts log component.

choice RTS_LOG_LEVEL
    prompt "Maximum log level"
    default RTS_LOG_LEVEL_INFO
    depends on RTS_LOG_ENABLE
    help
        Select the maximum log level to output.
    config RTS_LOG_LEVEL_NONE
        bool "No output"
    config RTS_LOG_LEVEL_ERROR
        bool "Error"
    config RTS_LOG_LEVEL_WARN
        bool "Warning"
    config RTS_LOG_LEVEL_INFO
        bool "Info"
    config RTS_LOG_LEVEL_DEBUG
        bool "Debug"
endchoice

choice RTS_LOG_BACKEND
    prompt "Log backend"
    default RTS_LOG_BACKEND_RTT
    depends on RTS_LOG_ENABLE
    help
        Select the backend for log output.

    config RTS_LOG_BACKEND_RTT
        bool "RTT backend"

    config RTS_LOG_BACKEND_CUSTOM
        bool "Custom backend"

endchoice

config SEGGER_RTT_MAX_NUM_UP_BUFFERS
    int "Number of RTT up-buffers (target to host)"
    default 1
    depends on RTS_LOG_ENABLE && RTS_LOG_BACKEND_RTT
    help
        Set the number of RTT up-buffers (target to host) available on this target.
        This option is only available when RTT backend is selected.

config SEGGER_RTT_BUFFER_SIZE_UP
    int "Size of RTT up-buffer (target to host)"
    default 128
    depends on RTS_LOG_ENABLE && RTS_LOG_BACKEND_RTT
    help
        Set the size of the RTT up-buffer (target to host) available on this target.
        This option is only available when RTT backend is selected.

config SEGGER_RTT_MAX_NUM_DOWN_BUFFERS
    int "Number of RTT down-buffers (host to target)"
    default 1
    depends on RTS_LOG_ENABLE && RTS_LOG_BACKEND_RTT
    help
        Set the number of RTT down-buffers (host to target) available on this target.
        This option is only available when RTT backend is selected.

config SEGGER_RTT_BUFFER_SIZE_DOWN
    int "Size of RTT down-buffer (host to target)"
    default 16
    depends on RTS_LOG_ENABLE && RTS_LOG_BACKEND_RTT
    help
        Set the size of the RTT down-buffer (host to target) available on this target.
        This option is only available when RTT backend is selected.

config RTS_LOG_USE_COLOR
    bool "Use color for log output"
    default y
    depends on RTS_LOG_ENABLE && RTS_LOG_BACKEND_RTT
    help
        Enable this to add ANSI color codes to the log output.
        This option is only available when RTT backend is selected.

endmenu
```
